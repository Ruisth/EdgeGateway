## yocto/layers/meta-edgegateway/conf/layer.conf
```bitbake
# SPDX-License-Identifier: Apache-2.0
#
# Layer configuration for meta-edgegateway. Esta camada concentra receitas
# descritas no EdgeGateway_Paper.pdf (containers, agentes blockchain, IA e
# observabilidade).

BBPATH .= ":${LAYERDIR}"
BBFILES += "${LAYERDIR}/recipes-*/*/*.bb ${LAYERDIR}/recipes-*/*/*.bbappend"

BBFILE_COLLECTIONS += "meta-edgegateway"
BBFILE_PATTERN_meta-edgegateway = "^${LAYERDIR}/"
BBFILE_PRIORITY_meta-edgegateway = "6"

LAYERSERIES_COMPAT_meta-edgegateway = "kirkstone nanbield"
```
